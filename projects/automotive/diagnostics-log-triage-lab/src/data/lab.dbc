VERSION ""

NS_ :

BS_:

BU_: GW ECU

BO_ 256 VehicleDynamics: 8 GW
 SG_ VehicleSpeed : 0|16@1+ (0.01,0) [0|300] "km/h" ECU
 SG_ AliveCounter : 56|4@1+ (1,0) [0|15] "" ECU

BO_ 257 BodyStatus: 8 GW
 SG_ DoorState : 0|8@1+ (1,0) [0|3] "" ECU
 SG_ AliveCounter : 56|4@1+ (1,0) [0|15] "" ECU

BO_ 512 AdasObject: 64 GW
 SG_ ObjDistance : 0|16@1+ (0.01,0) [0|250] "m" ECU

BA_DEF_ BO_  "GenMsgCycleTime" INT 0 10000;
BA_DEF_ BO_  "VFrameFormat" ENUM  "StandardCAN","ExtendedCAN","reserved","reserved","reserved","reserved","reserved","reserved","reserved","reserved","reserved","reserved","reserved","reserved","StandardCAN_FD","ExtendedCAN_FD";
BA_DEF_DEF_  "GenMsgCycleTime" 0;
BA_DEF_DEF_  "VFrameFormat" "StandardCAN";
BA_ "GenMsgCycleTime" BO_ 256 20;
BA_ "GenMsgCycleTime" BO_ 257 100;
BA_ "GenMsgCycleTime" BO_ 512 50;
BA_ "VFrameFormat" BO_ 512 14;
